#include "oled_display.h"

// Initialize the display object
Adafruit_SSD1306 display(SCREEN_WIDTH, SCREEN_HEIGHT,
                         OLED_MOSI, OLED_CLK, OLED_DC, OLED_RESET, OLED_CS);

// The logo bitmap
const unsigned char fireshield360_logo[] PROGMEM = {
    0xff, 0xff, 0xff, 0xff, 0xff, 0xff, 0xff, 0xff, 0xff, 0xff, 0xff, 0xff, 0xff, 0xff, 0xff, 0xff,
    0xff, 0xff, 0xff, 0xff, 0xff, 0xff, 0xff, 0xff, 0xff, 0xff, 0xff, 0xff, 0xff, 0xff, 0xff, 0xff,
    0xff, 0xff, 0xff, 0xff, 0xff, 0xff, 0xff, 0xff, 0xff, 0xff, 0xff, 0xff, 0xff, 0xff, 0xff, 0xff,
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    0xff, 0xff, 0xff, 0xff, 0xff, 0xff, 0xff, 0xff, 0xff, 0xff, 0xff, 0xff, 0xff, 0xff, 0xff, 0xff};

// Warning icon bitmap (16x16 pixels, triangle with exclamation mark)
const unsigned char warning_icon[] PROGMEM = {
    0x00, 0x00, // 0000000000000000
    0x00, 0x00, // 0000000000000000
    0x01, 0x00, // 0000000100000000
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    0x00, 0x00  // 0000000000000000
};

// Fire animation frames (32x32 pixels each, 3 frames)
const unsigned char fire_anim_1[] PROGMEM = {
    0x00, 0x00, 0x00, 0x00, 0x00, 0x01, 0x80, 0x00, 0x00, 0x03, 0xC0, 0x00, 0x00, 0x07, 0xE0, 0x00,
    0x00, 0x0F, 0xF0, 0x00, 0x00, 0x1F, 0xF8, 0x00, 0x00, 0x3F, 0xFC, 0x00, 0x00, 0x7F, 0xFE, 0x00,
    0x00, 0xFF, 0xFF, 0x00, 0x01, 0xFA, 0x5F, 0x80, 0x03, 0xF0, 0x0F, 0xC0, 0x07, 0xE0, 0x07, 0xE0,
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    0x1F, 0xFF, 0xFF, 0xF8, 0x0F, 0xFF, 0xFF, 0xF0, 0x07, 0xFF, 0xFF, 0xE0, 0x01, 0xFF, 0xFF, 0x80};

const unsigned char fire_anim_2[] PROGMEM = {
    0x00, 0x00, 0x00, 0x00, 0x00, 0x00, 0x00, 0x00, 0x00, 0x01, 0x80, 0x00, 0x00, 0x03, 0xC0, 0x00,
    0x00, 0x07, 0xE0, 0x00, 0x00, 0x0F, 0xF0, 0x00, 0x00, 0x1F, 0xF8, 0x00, 0x00, 0x3F, 0xFC, 0x00,
    0x00, 0x7F, 0xFE, 0x00, 0x00, 0xFE, 0x7F, 0x00, 0x01, 0xFC, 0x3F, 0x80, 0x03, 0xF8, 0x1F, 0xC0,
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    0x0F, 0xFF, 0xFF, 0xF0, 0x07, 0xFF, 0xFF, 0xE0, 0x03, 0xFF, 0xFF, 0xC0, 0x00, 0xFF, 0xFF, 0x00};

const unsigned char fire_anim_3[] PROGMEM = {
    0x00, 0x00, 0x00, 0x00, 0x00, 0x01, 0x80, 0x00, 0x00, 0x03, 0xC0, 0x00, 0x00, 0x07, 0xE0, 0x00,
    0x00, 0x0F, 0xF0, 0x00, 0x00, 0x1F, 0xF8, 0x00, 0x00, 0x3F, 0xFC, 0x00, 0x00, 0x7F, 0xFE, 0x00,
    0x00, 0xFF, 0xFF, 0x00, 0x01, 0xFE, 0x7F, 0x80, 0x03, 0xFC, 0x3F, 0xC0, 0x07, 0xF0, 0x0F, 0xE0,
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    0x07, 0xFF, 0xFF, 0xE0, 0x03, 0xFF, 0xFF, 0xC0, 0x01, 0xFF, 0xFF, 0x80, 0x00, 0x7F, 0xFE, 0x00};

// Large warning triangle icon for alert
const unsigned char large_warning_icon[] PROGMEM = {
    0x00, 0x00, 0x00, 0x00, 0x00, 0x00, 0x80, 0x00, 0x00, 0x01, 0xC0, 0x00, 0x00, 0x03, 0xE0, 0x00,
    0x00, 0x07, 0xF0, 0x00, 0x00, 0x0F, 0xF8, 0x00, 0x00, 0x1F, 0xFC, 0x00, 0x00, 0x3F, 0xFE, 0x00,
    0x00, 0x7F, 0xFF, 0x00, 0x00, 0xFF, 0xFF, 0x80, 0x01, 0xFF, 0xFF, 0xC0, 0x03, 0xFF, 0xFF, 0xE0,
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    0x01, 0xFF, 0xFF, 0xC0, 0x00, 0xFF, 0xFF, 0x80, 0x00, 0x7F, 0xFF, 0x00, 0x00, 0x3F, 0xFE, 0x00};

bool initDisplay()
{
    if (!display.begin(SSD1306_SWITCHCAPVCC))
    {
        Serial.println(F("SSD1306 allocation failed"));
        return false;
    }

    display.clearDisplay();
    display.display();
    return true;
}

void displaySplashScreen(uint16_t displayTime)
{
    display.clearDisplay();
    display.drawBitmap(0, 0, fireshield360_logo, SCREEN_WIDTH, SCREEN_HEIGHT, SSD1306_WHITE);
    display.display();
    delay(displayTime);
}

void clearDisplay()
{
    display.clearDisplay();
    display.display();
}

void allPixels()
{
    int i;
    int j;
    display.clearDisplay();
    for (i = 0; i < 64; i++)
    {
        for (j = 0; j < 128; j++)
        {
            display.drawPixel(j, i, SSD1306_WHITE);
        }
        display.display();
        delay(30);
    }

    for (i = 0; i < 64; i++)
    {
        for (j = 0; j < 128; j++)
        {
            display.drawPixel(j, i, SSD1306_BLACK);
        }
        display.display();
        delay(30);
    }
}

void textDisplay(const String &text)
{
    display.clearDisplay();
    display.setTextSize(1);
    display.setTextColor(SSD1306_WHITE);
    // Center the text horizontally
    int16_t x1, y1;
    uint16_t w, h;
    display.getTextBounds(text, 0, 0, &x1, &y1, &w, &h);
    int16_t x = (SCREEN_WIDTH - w) / 2;
    int16_t y = 28; // keep vertical position as before
    display.setCursor(x, y);
    display.println(text);
    display.display();
    delay(3000);
}

void invertedTextDisplay(const String &text)
{
    display.clearDisplay();
    display.setTextColor(SSD1306_BLACK, SSD1306_WHITE);
    display.setCursor(5, 28);
    display.println(text);
    display.display();
    delay(3000);
}

void scrollText()
{
    display.clearDisplay();
    display.setCursor(0, 0);
    display.setTextSize(1);
    display.setTextColor(SSD1306_WHITE);
    display.println("This is a");
    display.println("Scrolling");
    display.println("Text!");
    display.display();
    delay(100);
    display.startscrollright(0x00, 0x0F);
    delay(2000);
    display.startscrollleft(0x00, 0x0F);
    delay(2000);
    display.startscrolldiagright(0x00, 0x0F);
    delay(2000);
    display.startscrolldiagleft(0x00, 0x0F);
    delay(2000);
    display.stopscroll();
}

void displayChars()
{
    display.clearDisplay();
    display.setTextSize(1);
    display.setTextColor(SSD1306_WHITE);
    display.setCursor(0, 0);
    display.cp437(true);

    for (int16_t i = 0; i < 256; i++)
    {
        if (i == '\n')
        {
            display.write(' ');
        }
        else
        {
            display.write(i);
        }
    }

    display.display();
    delay(4000);
}

void textSize()
{
    display.clearDisplay();

    display.setTextSize(1);
    display.setTextColor(SSD1306_WHITE);
    display.setCursor(0, 0);
    display.println(F("Size: 1"));
    display.println(F("ABC"));

    display.setTextSize(2);
    display.setTextColor(SSD1306_WHITE);
    display.println("Size: 2");
    display.println(F("ABC"));

    display.display();
    delay(3000);
}

void drawRectangle()
{
    display.clearDisplay();
    display.setTextSize(1);
    display.setTextColor(SSD1306_WHITE);
    display.setCursor(0, 0);
    display.println("Rectangle");
    display.drawRect(0, 15, 90, 45, SSD1306_WHITE);
    display.display();
    delay(2000);
}

void drawFilledRectangle()
{
    display.clearDisplay();
    display.setTextSize(1);
    display.setTextColor(SSD1306_WHITE);
    display.setCursor(0, 0);
    display.println("Filled Rectangle");
    display.fillRect(0, 15, 90, 45, SSD1306_WHITE);
    display.display();
    delay(2000);
}

void drawRoundRectangle()
{
    display.clearDisplay();
    display.setTextSize(1);
    display.setTextColor(SSD1306_WHITE);
    display.setCursor(0, 0);
    display.println("Round Rectangle");
    display.drawRoundRect(0, 15, 90, 45, 10, SSD1306_WHITE);
    display.display();
    delay(2000);
}

void drawFilledRoundRectangle()
{
    display.clearDisplay();
    display.setTextSize(1);
    display.setTextColor(SSD1306_WHITE);
    display.setCursor(0, 0);
    display.println("Filled Round Rect");
    display.fillRoundRect(0, 15, 90, 45, 10, SSD1306_WHITE);
    display.display();
    delay(2000);
}

void drawCircle()
{
    display.clearDisplay();
    display.setTextSize(1);
    display.setTextColor(SSD1306_WHITE);
    display.setCursor(0, 0);
    display.println("Circle");
    display.drawCircle(30, 36, 25, SSD1306_WHITE);
    display.display();
    delay(2000);
}

void drawFilledCircle()
{
    display.clearDisplay();
    display.setTextSize(1);
    display.setTextColor(SSD1306_WHITE);
    display.setCursor(0, 0);
    display.println("Filled Circle");
    display.fillCircle(30, 36, 25, SSD1306_WHITE);
    display.display();
    delay(2000);
}

void drawTriangle()
{
    display.clearDisplay();
    display.setTextSize(1);
    display.setTextColor(SSD1306_WHITE);
    display.setCursor(0, 0);
    display.println("Triangle");
    display.drawTriangle(30, 15, 0, 60, 60, 60, SSD1306_WHITE);
    display.display();
    delay(2000);
}

void drawFilledTriangle()
{
    display.clearDisplay();
    display.setTextSize(1);
    display.setTextColor(SSD1306_WHITE);
    display.setCursor(0, 0);
    display.println("Filled Triangle");
    display.fillTriangle(30, 15, 0, 60, 60, 60, SSD1306_WHITE);
    display.display();
    delay(2000);
}

void displaySensorData(float temperature, float humidity, int smokeValue)
{
    display.clearDisplay();

    // Set text properties
    display.setTextSize(1);
    display.setTextColor(SSD1306_WHITE);

    // Display title
    display.setCursor(0, 0);
    display.println("Sensor Readings:");

    // Display temperature
    display.setCursor(0, 16);
    display.print("Temp: ");
    display.print(temperature);
    display.println(" C");

    // Display humidity
    display.setCursor(0, 26);
    display.print("Humidity: ");
    display.print(humidity);
    display.println(" %");

    // Display smoke value
    display.setCursor(0, 36);
    display.print("Smoke: ");
    display.println(smokeValue);

    // Display time since last update
    display.setCursor(0, 46);
    display.print("Last update: ");
    display.print(millis() / 1000);
    display.println("s");

    // Update the display
    display.display();
}

void displaySensorData(float temperature, float humidity, int smokeValue, bool wildfireDetected)
{
    display.clearDisplay();

    // Define the display bands
    const int YELLOW_BAND_HEIGHT = 16; // 25% of 64 pixels (2 rows of text)

    // Draw the yellow band on top (for title area)
    display.fillRect(0, 0, SCREEN_WIDTH, YELLOW_BAND_HEIGHT, SSD1306_WHITE);

    // Set text properties for title in yellow area (black text on yellow background)
    display.setTextSize(1);
    display.setTextColor(SSD1306_BLACK);

    if (wildfireDetected)
    {
        // Animate the warning text in the yellow band
        int animPhase = (millis() / 200) % 4; // 4 animation phases, changing every 200ms

        switch (animPhase)
        {
        case 0:
            display.setCursor(4, 4);
            display.print("! WILDFIRE ALERT !");
            break;
        case 1:
            display.setCursor(4, 4);
            display.print(" WILDFIRE ALERT  ");
            break;
        case 2:
            display.setCursor(4, 4);
            display.print("  WILDFIRE ALERT ");
            break;
        case 3:
            display.setCursor(4, 4);
            display.print(" ! DANGER ! ");
            break;
        }

        // Draw small warning triangle on the right side
        display.drawBitmap(110, 0, warning_icon, 16, 16, SSD1306_BLACK);
    }
    else
    {
        display.setCursor(0, 4); // Center vertically in yellow band
        display.println(" Sensor Readings ");
    }

    // Switch to white text on black for the blue area
    display.setTextColor(SSD1306_WHITE);

    // Start a bit closer to the yellow band to save space
    int yPos = YELLOW_BAND_HEIGHT + 1;

    // Display temperature with threshold indicator
    display.setCursor(0, yPos);
    display.print("Temp: ");
    display.print(temperature);
    display.print(" C");
    if (isTemperatureExceedingThreshold(temperature))
    {
        display.print(" !");
    }
    yPos += 9; // Reduce spacing from 10 to 9

    // Display humidity with threshold indicator
    display.setCursor(0, yPos);
    display.print("Humidity: ");
    display.print(humidity);
    display.print(" %");
    if (isHumidityBelowThreshold(humidity))
    {
        display.print(" !");
    }
    yPos += 9; // Reduce spacing from 10 to 9

    // Display smoke value with threshold indicator
    display.setCursor(0, yPos);
    display.print("Smoke: ");
    display.print(smokeValue);
    if (isSmokeExceedingThreshold(smokeValue))
    {
        display.print(" !");
    }
    yPos += 9; // Reduce spacing from 10 to 9

    // Display thresholds exceeded
    display.setCursor(0, yPos);
    int thresholdsExceeded = getNumberOfThresholdsExceeded(temperature, humidity, smokeValue);
    display.print("Alerts: ");
    display.print(thresholdsExceeded);
    display.print("/3");
    yPos += 9; // Reduce spacing from 10 to 9

    // Display time since last update - ensure it's fully visible
    display.setCursor(0, yPos);
    display.print("Update: "); // Shortened from "Last update: " to save space
    display.print(millis() / 1000);
    display.print("s"); // Removed println to avoid extra line feed

    // Update the display
    display.display();
}